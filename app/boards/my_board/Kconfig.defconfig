## app/boards/my_board/Kconfig.defconfig
```kconfig
# SPDX-License-Identifier: Apache-2.0

if BOARD_MY_BOARD

config BUILD_OUTPUT_BIN
	default n

config QEMU_TARGET
	default y

config HAS_COVERAGE_SUPPORT
	default y

config FLASH_SIMULATOR
	default y
	depends on FLASH

config MULTIBOOT
	default y

config MULTIBOOT_INFO
	default y if MULTIBOOT

config MULTIBOOT_MEMMAP
	default y if MULTIBOOT

config QEMU_ICOUNT_SHIFT
	default 5

endif # BOARD_MY_BOARD
```

## app/boards/my_board/Kconfig.my_board
```kconfig
# SPDX-License-Identifier: Apache-2.0

config BOARD_MY_BOARD
	select SOC_ATOM
	select CPU_HAS_FPU
```

## app/boards/my_board/board.yml
```yaml
board:
  name: my_board
  full_name: My Custom QEMU X86 Board
  vendor: qemu
  socs:
    - name: atom
```

## app/boards/our_board/board.yml
```yaml
board:
  name: our_board
  full_name: Our ESP32S3 Board
  vendor: me
  socs:
  - name: esp32s3
```

## our-driver-module/drivers/our_driver/Kconfig
```kconfig
menuconfig OUR_DRIVER
	bool "Our Custom LED Sensor Driver"
	default y
	depends on DT_HAS_OUR_DRIVER_ENABLED
	select GPIO
	select SENSOR
	help
	  Enable driver support for the on-board LED sensor.
```

## our-driver-module/dts/bindings/driver/our,driver.yaml
```yaml
description: On-board LED Sensor Driver Binding
compatible: "our,driver"
include: base.yaml
properties:
  led-gpios:
    type: phandle-array
    required: true
```
